## conf/machine/tm4ksuper.conf
```bitbake
#
# This is config file for Technomate TM 4K super
#

MTD_KERNEL = "mmcblk0p1"
MTD_ROOTFS = "mmcblk0p4"
SPLASH1_BMP = "splash1_power.bmp"

IMAGEDIR = "update/tm4ksuper"

MACHINE_ESSENTIAL_EXTRA_RDEPENDS = "\
    dags-dvb-modules-dags7252-300 \
    "

include conf/machine/include/dags-arm.inc

PREFERRED_VERSION_linux-dags = "3.14.28"

SOC_FAMILY = "bcm7252s"

MACHINE_FEATURES += "emmc mmc omb transcoding fastscan dvb-c"
#MACHINE_FEATURES += "bootsplash"
```

## conf/machine/tmnano.conf
```bitbake
#
# This is config file for Technomate TM-NANO-OE
#

MTD_KERNEL = "mtd1"
MTD_ROOTFS = "mtd0"

IMAGEDIR = "update/tmnanooe/cfe"

MACHINE_ESSENTIAL_EXTRA_RDEPENDS += "\
    dags-dvb-modules-dags7335 \
    "

include conf/machine/include/dags-mips.inc

PREFERRED_VERSION_linux-dags = "3.9.7"

SOC_FAMILY = "bcm7335"

MACHINE_FEATURES += "fan wifiusbmodule blindscan-tbs"
#MACHINE_FEATURES += "bootsplash"
```

## conf/machine/tmnano2super.conf
```bitbake
#
# This is config file for Technomate TM-NANO 2 Super
#

MTD_KERNEL = "mtd2"
MTD_ROOTFS = "mtd0"
SPLASH1_BMP = "splash1.bmp"

IMAGEDIR = "update/tmnano2super/cfe"

MACHINE_ESSENTIAL_EXTRA_RDEPENDS += "\
    dags-dvb-modules-dags7356tm \
    "

include conf/machine/include/dags-mips.inc

PREFERRED_VERSION_linux-dags = "3.9.7"

SOC_FAMILY = "bcm7356"

MACHINE_FEATURES += "fan omb wifiusbmodule blindscan-tbs"
#MACHINE_FEATURES += "bootsplash"
```

## conf/machine/tmnano2t.conf
```bitbake
#
# This is config file for Technomate TM-NANO-2T
#

MTD_KERNEL = "mtd1"
MTD_ROOTFS = "mtd0"

IMAGEDIR = "update/tmnano2t/cfe"

MACHINE_ESSENTIAL_EXTRA_RDEPENDS += "\
    dags-dvb-modules-dags7335 \
    kernel-module-dvb-usb \
    edision-tuner-edicombo \
    "

include conf/machine/include/dags-mips.inc

PREFERRED_VERSION_linux-dags = "3.9.7"

SOC_FAMILY = "bcm7335"

MACHINE_FEATURES += "fan wifiusbmodule blindscan-tbs"
#MACHINE_FEATURES += "bootsplash"
```

## conf/machine/tmnano3t.conf
```bitbake
#
# This is config file for Technomate TM-NANO-3T Combo
#

MTD_KERNEL = "mtd2"
MTD_ROOTFS = "mtd0"
SPLASH1_BMP = "splash1.bmp"

IMAGEDIR = "update/force1plus/cfe"

MACHINE_ESSENTIAL_EXTRA_RDEPENDS += "\
    dags-dvb-modules-dags7356tm \
    "

include conf/machine/include/dags-mips.inc

PREFERRED_VERSION_linux-dags = "3.9.7"

SOC_FAMILY = "bcm7356"

MACHINE_FEATURES += "fan wifiusbmodule blindscan-tbs"
#MACHINE_FEATURES += "bootsplash"
```

## conf/machine/tmnanosem2.conf
```bitbake
#
# This is config file for Technomate TM-NANO-SE M2
#

MTD_KERNEL = "mtd2"
MTD_ROOTFS = "mtd0"
SPLASH1_BMP = "splash1_power.bmp"

IMAGEDIR = "update/tmnanosem2/cfe"

MACHINE_ESSENTIAL_EXTRA_RDEPENDS += "\
    dags-dvb-modules-dags7362 \
    "

require conf/machine/include/dags-mips.inc

PREFERRED_VERSION_linux-dags = "4.2.1"

SOC_FAMILY = "bcm7362"

MACHINE_FEATURES += "blindscan-tbs fan fastscan dvb-c AV_JACK"
```

## conf/machine/tmsingle.conf
```bitbake
#
# This is config file for Technomate TM-Single
#

MTD_KERNEL = "mtd6"
MTD_ROOTFS = "mtd4"

IMAGEDIR = "update/tmsingle/cfe"

MACHINE_ESSENTIAL_EXTRA_RDEPENDS += "\
    dags-dvb-modules-dags7335 \
    "

include conf/machine/include/dags-mips.inc

PREFERRED_VERSION_linux-dags = "3.9.7"

SOC_FAMILY = "bcm7335"

MACHINE_FEATURES += "fan omb wifiusbmodule blindscan-tbs"
#MACHINE_FEATURES += "bootsplash"
```

## conf/machine/tmtwin.conf
```bitbake
#
# This is config file for Technomate TM-Twin-OE
#

MTD_KERNEL = "mtd6"
MTD_ROOTFS = "mtd4"

IMAGEDIR = "update/tmtwinoe/cfe"

MACHINE_ESSENTIAL_EXTRA_RDEPENDS += "\
    dags-dvb-modules-dags7335 \
    edision-tuner-edicombo \
    "

require conf/machine/include/dags-mips.inc

PREFERRED_VERSION_linux-dags = "3.9.7"

SOC_FAMILY = "bcm7335"

MACHINE_FEATURES += "fan wifiusbmodule blindscan-tbs"
```

## conf/machine/tmtwin4k.conf
```bitbake
#
# This is config file for Technomate TM-Twin-4K
#

MTD_KERNEL = "mmcblk0p1"
MTD_ROOTFS = "mmcblk0p4"
SPLASH1_BMP = "splash1_power.bmp"

IMAGEDIR = "update/tmtwin4k"

MACHINE_ESSENTIAL_EXTRA_RDEPENDS = "\
    dags-dvb-modules-dags7252-200 \
    "

include conf/machine/include/dags-arm.inc

PREFERRED_VERSION_linux-dags = "3.14.28"

SOC_FAMILY = "bcm7252s"

MACHINE_FEATURES += "emmc mmc omb transcoding fan fastscan dvb-c"
#MACHINE_FEATURES += "bootsplash"
```

## conf/machine/worldvisionf1.conf
```bitbake
#
# This is config file for WorldVision Force 1
#

MTD_KERNEL = "mtd2"
MTD_ROOTFS = "mtd0"
SPLASH1_BMP = "splash1_os1.bmp"

IMAGEDIR = "update/force1/cfe"

MACHINE_ESSENTIAL_EXTRA_RDEPENDS += "\
    dags-dvb-modules-dags7356f1 \
    "

include conf/machine/include/dags-mips.inc

PREFERRED_VERSION_linux-dags = "3.9.7"

SOC_FAMILY = "bcm7356"

MACHINE_FEATURES += "fan wifiusbmodule blindscan-tbs"
```
