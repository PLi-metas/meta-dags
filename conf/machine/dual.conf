## conf/machine/dual.conf
```bitbake
#@TYPE: Machine
#@NAME: dual
#@DESCRIPTION: Machine configuration for Qviart Dual 4K UHD

require conf/machine/include/dags-hisi.inc

IMAGEDIR = "dual"
```

## conf/machine/force1.conf
```bitbake
#
# This is config file for Iqon Force 1
#

MTD_KERNEL = "mtd2"
MTD_ROOTFS = "mtd0"
SPLASH1_BMP = "splash1_os2.bmp"

IMAGEDIR = "update/force1/cfe"

MACHINE_ESSENTIAL_EXTRA_RDEPENDS += "\
    dags-dvb-modules-dags7356 \
    kernel-module-dvb-usb \
    edision-tuner-edicombo \
    "

include conf/machine/include/dags-mips.inc

PREFERRED_VERSION_linux-dags = "3.9.7"

SOC_FAMILY = "bcm7356"

MACHINE_FEATURES += "fan wifiusbmodule blindscan-tbs"
#MACHINE_FEATURES += "bootsplash"
```

## conf/machine/force2plus.conf
```bitbake
#
# This is config file for Iqon Force 2 Plus
#

MTD_KERNEL = "mtd2"
MTD_ROOTFS = "mtd0"
SPLASH1_BMP = "splash1_power.bmp"

IMAGEDIR = "update/force2plus/cfe"

MACHINE_ESSENTIAL_EXTRA_RDEPENDS += "\
    dags-dvb-modules-dags7362 \
    "

include conf/machine/include/dags-mips.inc

PREFERRED_VERSION_linux-dags = "4.2.1"

SOC_FAMILY = "bcm7362"

MACHINE_FEATURES += "wifiusbmodule blindscan-tbs"
#MACHINE_FEATURES += "bootsplash"
```

## conf/machine/force2plushv.conf
```bitbake
#
# This is config file for Iqon Force 2 Plus HV
#

MTD_KERNEL = "mtd2"
MTD_ROOTFS = "mtd0"
SPLASH1_BMP = "splash1_power.bmp"

IMAGEDIR = "update/force2plushv/cfe"

MACHINE_ESSENTIAL_EXTRA_RDEPENDS = "\
    dags-dvb-modules-dags73625 \
    "

include conf/machine/include/dags-mips.inc

PREFERRED_VERSION_linux-dags = "4.2.1"

SOC_FAMILY = "bcm73625"

MACHINE_FEATURES += "omb wifiusbmodule blindscan-tbs fastscan dvb-c"
#MACHINE_FEATURES += "bootsplash"
```

## conf/machine/force2se.conf
```bitbake
#
# This is config file for Iqon Force 2 SE
#

MTD_KERNEL = "mtd2"
MTD_ROOTFS = "mtd0"
SPLASH1_BMP = "splash1_power.bmp"

IMAGEDIR = "update/force2se/cfe"

MACHINE_ESSENTIAL_EXTRA_RDEPENDS += "\
    dags-dvb-modules-dags7362 \
    "

require conf/machine/include/dags-mips.inc

PREFERRED_VERSION_linux-dags = "4.2.1"

SOC_FAMILY = "bcm7362"

MACHINE_FEATURES += "wifiusbmodule blindscan-tbs"
```

## conf/machine/fusionhd.conf
```bitbake
#
# This is config file for Xsarius Fusion HD
#

MTD_KERNEL = "mtd2"
MTD_ROOTFS = "mtd0"
SPLASH1_BMP = "splash1_power.bmp"

IMAGEDIR = "update/fusionhd/cfe"

MACHINE_ESSENTIAL_EXTRA_RDEPENDS += "\
    dags-dvb-modules-dags7362 \
    "

include conf/machine/include/dags-mips.inc

PREFERRED_VERSION_linux-dags = "4.2.1"

SOC_FAMILY = "bcm7362"

MACHINE_FEATURES += "wifiusbmodule blindscan-tbs"
```

## conf/machine/include/dags-hisi.inc
```bitbake
include conf/machine/include/dags-oem.inc

DISTRO_FEATURES_remove += "x11 wayland"

KERNELVERSION = "4.4.35"

SOC_FAMILY = "hisi3798mv200"
HICHIPSET = "3798mv200"
CHIPSET = "Hi3798Mv200"

KERNEL_FILE = "kernel.bin"
ROOTFS_FILE = "rootfs.tar.bz2"
MTD_BLACK  = "mmcblk0"

MTD_KERNEL = "mmcblk0p12"
MTD_ROOTFS = "mmcblk0p13"

MACHINE_ESSENTIAL_EXTRA_RDEPENDS += "\
	dags-reader-${SOC_FAMILY} \
	dags-libreader-${SOC_FAMILY} \
	dags-loadmodules-${SOC_FAMILY} \
	e2fsprogs-resize2fs \
	dags-libs-${SOC_FAMILY} \
	kernel-module-extrawlan-rtl8192eu \
	firmware-rtl8192eu \
	dags-bootoptions-${MACHINE} \
	dags-buildimage \
	deepsleep-${SOC_FAMILY} \
	"

MACHINE_FEATURES += "emmc mmc 7segment hisi mali AV_JACK multitranscoding fastboot"

MACHINE_FEATURES_remove += "ci"

IMAGE_CLASSES += "dags-emmc_image"
IMAGE_FSTYPES += "dagsemmc"
IMAGE_ROOTFS_SIZE ?= "524288"

TARGET_ARCH = "arm"
DEFAULTTUNE = "cortexa15hf-neon-vfpv4"

PREFERRED_PROVIDER_virtual/enigma2-mediaservice = "enigma2-plugin-systemplugins-servicehisilicon"

require conf/machine/include/tune-cortexa15.inc

IMAGE_CMD_dagsemmc_append = "\
	mkdir -p ${DEPLOY_DIR_IMAGE}/${IMAGEDIR}; \
	mkdir -p ${DEPLOY_DIR_IMAGE}/release/${IMAGEDIR}; \
	cp ${DEPLOY_DIR_IMAGE}/uImage ${DEPLOY_DIR_IMAGE}/${IMAGEDIR}/${KERNEL_FILE}; \
	mv ${IMGDEPLOYDIR}/${IMAGE_NAME}_subrootfs.ext4 ${DEPLOY_DIR_IMAGE}/${IMAGEDIR}/rootfs.ext4; \
	echo ${IMAGE_NAME} > ${DEPLOY_DIR_IMAGE}/${IMAGEDIR}/imageversion; \
	echo "https://forum.openvision.tech/app.php/donate" > ${DEPLOY_DIR_IMAGE}/${IMAGEDIR}/donate.txt; \
	cd ${DEPLOY_DIR_IMAGE}; \
	zip ${IMAGE_NAME}_recovery_mmc.zip ${IMAGEDIR}/*; \
	cd ${IMAGE_ROOTFS}; \
	tar -cvf ${DEPLOY_DIR_IMAGE}/rootfs.tar -C ${IMAGE_ROOTFS} .; \
	mv ${DEPLOY_DIR_IMAGE}/rootfs.tar ${DEPLOY_DIR_IMAGE}/${IMAGEDIR}/rootfs.tar; \
	cd ${DEPLOY_DIR_IMAGE}; \
	bzip2 ${DEPLOY_DIR_IMAGE}/${IMAGEDIR}/rootfs.tar; \
	zip -j ${IMAGE_NAME}_mmc.zip ${DEPLOY_DIR_IMAGE}/${IMAGEDIR}/imageversion ${DEPLOY_DIR_IMAGE}/${IMAGEDIR}/donate.txt ${DEPLOY_DIR_IMAGE}/${IMAGEDIR}/${KERNEL_FILE} ${DEPLOY_DIR_IMAGE}/${IMAGEDIR}/${ROOTFS_FILE}; \
	rm -f ${DEPLOY_DIR_IMAGE}/*.ext4; \
	rm -Rf ${DEPLOY_DIR_IMAGE}/rootfs; \
	rm -Rf ${IMAGEDIR}; \
	rm -Rf release; \
	"

IMAGE_CMD_prepend = "\
	rm -Rf ${IMAGE_ROOTFS}/tmp/*; \
	rm -Rf ${DEPLOY_DIR_IMAGE}/rootfs; \
	"

DVBMEDIASINK_CONFIG += "--with-h265 --with-vb8 --with-vb9 --with-spark --with-dts"

EXTRA_OECONF_append_pn-enigma2 = "--with-lcddev=/dev/null --with-alphablendingacceleration=always --with-blitaccelerationthreshold=250  --with-fillaccelerationthreshold=190000 --with-subttxtabnormalptsdiffs=3600000"

EXTRA_ALSA = "mv200"

STB_PLATFORM = "dagsmv200"

RCNAME = "qviart5"
```

## conf/machine/include/dags-oem.inc
```bitbake
# We know about rtc
MACHINE_FEATURES_BACKFILL_CONSIDERED += "rtc"

BOX_BRAND = "dags"

MACHINE_FEATURES += "alsa hdmicec switchoff textlcd ci dags HDMI"

BOOTLOGO_FILENAME = "splash.bmp"

DVBPROVIDER = "kernel"
DVBSKYPROVIDER = "kernel"

MACHINE_ESSENTIAL_EXTRA_RDEPENDS += "\
	${@bb.utils.contains("SOC_FAMILY", "hisi3798mv200", "dagsmv200-shutdown" , "dags-shutdown", d)} \
	"

GLIBC_EXTRA_OECONF = "--with-tls"
DVBMEDIASINK_CONFIG = "${@bb.utils.contains("SOC_FAMILY", "", "--with-dags" , "dags-shutdown", d)} --with-pcm --with-eac3 --with-amr --with-wmv"

PREFERRED_PROVIDER_virtual/kernel = "linux-dags"
PREFERRED_PROVIDER_virtual/egl = "${@bb.utils.contains("SOC_FAMILY", "hisi3798mv200", "dags-opengl-${SOC_FAMILY}" , "v3d-libgles-${STB_PLATFORM}", d)}" 
PREFERRED_PROVIDER_virtual/libgles1 = "${@bb.utils.contains("SOC_FAMILY", "hisi3798mv200", "dags-opengl-${SOC_FAMILY}" , "v3d-libgles-${STB_PLATFORM}", d)}"
PREFERRED_PROVIDER_virtual/libgles2 = "${@bb.utils.contains("SOC_FAMILY", "hisi3798mv200", "dags-opengl-${SOC_FAMILY}" , "v3d-libgles-${STB_PLATFORM}", d)}"
PREFERRED_PROVIDER_virtual/blindscan-dvbs ?= "dags-blindscan-utils"

require conf/machine/include/soc-family.inc

BLINDSCAN_BINARY = "dags_blindscan"

RCNAME ?= "optimuss1"

PREFERRED_VERSION_linux-dags = "${KERNELVERSION}"
```

## conf/machine/include/dags7252.inc
```bitbake
require conf/machine/include/dags-arm.inc

KERNELVERSION = "3.14.28"

PREFERRED_VERSION_linux-dags = "${KERNELVERSION}"

SOC_FAMILY = "bcm7252s"

STB_PLATFORM = "dags7252"

MACHINE_FEATURES += "emmc mmc"

EXTRA_OECONF_append_pn-transtreamproxy = " --enable-ext-pid"
```

## conf/machine/include/dags7335.inc
```bitbake
require conf/machine/include/dags-mips.inc

KERNELVERSION = "3.9.7"

PREFERRED_VERSION_linux-dags = "${KERNELVERSION}"

SOC_FAMILY = "bcm7335"

STB_PLATFORM = "dags7335"

MACHINE_FEATURES += "fan blindscan-tbs"
```

## conf/machine/include/dags7356.inc
```bitbake
require conf/machine/include/dags-mips.inc

KERNELVERSION = "3.9.7"

PREFERRED_VERSION_linux-dags = "${KERNELVERSION}"

SOC_FAMILY = "bcm7356"

STB_PLATFORM = "dags7356"

MACHINE_FEATURES += "fan blindscan-tbs RCA"
```

## conf/machine/include/dags7362.inc
```bitbake
require conf/machine/include/dags-mips.inc

KERNELVERSION = "4.2.1"

PREFERRED_VERSION_linux-dags = "${KERNELVERSION}"

SOC_FAMILY = "bcm7362"

STB_PLATFORM = "dags7362"

MACHINE_FEATURES += "blindscan-tbs vfdsymbol"
```

## conf/machine/include/dags73625.inc
```bitbake
require conf/machine/include/dags-mips.inc

PREFERRED_VERSION_linux-dags = "4.2.1"

SOC_FAMILY = "bcm73625"

STB_PLATFORM = "dags73625"

MACHINE_FEATURES += "blindscan-tbs dvb-c"

MTD_KERNEL = "mtd2"
MTD_ROOTFS = "mtd0"
SPLASH1_BMP = "splash1_power.bmp"

MACHINE_ESSENTIAL_EXTRA_RDEPENDS += "\
    dags-dvb-modules-dags73625 \
    "
```

## conf/machine/iqonios200hd.conf
```bitbake
#
# This is config file for Iqon IOS-200HD, MediaArt 200HD and Roxxs 200HD
#

MTD_KERNEL = "mtd6"
MTD_ROOTFS = "mtd4"

IMAGEDIR = "update/ios200/cfe"

MACHINE_ESSENTIAL_EXTRA_RDEPENDS += "\
    dags-dvb-modules-dags7335ci \
    "

require conf/machine/include/dags-mips.inc

PREFERRED_VERSION_linux-dags = "3.9.7"

SOC_FAMILY = "bcm7335"

MACHINE_FEATURES += "fan blindscan-tbs RCA YUV"

STB_PLATFORM = "dags7335"
```

## conf/machine/iqonios300hdv2.conf
```bitbake
#
# This is config file for Iqon IOS-300HDV2
#

MTD_KERNEL = "mtd1"
MTD_ROOTFS = "mtd4"

IMAGEDIR = "update/ios300new/cfe"

MACHINE_ESSENTIAL_EXTRA_RDEPENDS += "\
    dags-dvb-modules-dags7335 \
    edision-tuner-edicombo \
    "

require conf/machine/include/dags-mips.inc

PREFERRED_VERSION_linux-dags = "3.9.7"

SOC_FAMILY = "bcm7335"

MACHINE_FEATURES += "fan wifiusbmodule blindscan-tbs"
```

## conf/machine/lunix.conf
```bitbake
#
# This is config file for Qviart Lunix
#

MTD_KERNEL = "mtd2"
MTD_ROOTFS = "mtd0"
SPLASH1_BMP = "splash1_power.bmp"

IMAGEDIR = "update/lunix/cfe"

MACHINE_ESSENTIAL_EXTRA_RDEPENDS += "\
    dags-dvb-modules-dags73625 \
    "

include conf/machine/include/dags-mips.inc

PREFERRED_VERSION_linux-dags = "4.2.1"

SOC_FAMILY = "bcm73625"

MACHINE_FEATURES += "wifiusbmodule blindscan-tbs fastscan dvb-c"
#MACHINE_FEATURES += "bootsplash"
```

## conf/machine/lunix34k.conf
```bitbake
#
# This is config file for Qviart Lunix3 4K
#

MTD_KERNEL = "mmcblk0p1"
MTD_ROOTFS = "mmcblk0p4"
SPLASH1_BMP = "splash1_power.bmp"

IMAGEDIR = "update/lunix3-4k"

MACHINE_ESSENTIAL_EXTRA_RDEPENDS += "\
    dags-dvb-modules-dags7252-300 \
    "

include conf/machine/include/dags-arm.inc

PREFERRED_VERSION_linux-dags = "3.14.28"

SOC_FAMILY = "bcm7252s"

MACHINE_FEATURES += "emmc mmc transcoding fastscan dvb-c"
#MACHINE_FEATURES += "bootsplash"
```

## conf/machine/lunix4k.conf
```bitbake
#
# This is config file for Qviart Lunix 4K
#

MTD_KERNEL = "mmcblk0p1"
MTD_ROOTFS = "mmcblk0p4"
SPLASH1_BMP = "splash1_power.bmp"

IMAGEDIR = "update/lunix4k"

MACHINE_ESSENTIAL_EXTRA_RDEPENDS += "\
    dags-dvb-modules-dags72604 \
    "

require conf/machine/include/dags-arm.inc

PREFERRED_VERSION_linux-dags = "4.1.20"

SOC_FAMILY = "bcm72604"

MACHINE_FEATURES += "emmc mmc fastscan dvb-c blindscan-dvbs"

DVBMEDIASINK_CONFIG = "--with-dags --with-pcm --with-eac3 --with-amr --with-wmv --with-h265 --with-vb9"
```

## conf/machine/optimussos.conf
```bitbake
#
# This is config file for Edision Optimuss OS
#

MTD_KERNEL = "mtd2"
MTD_ROOTFS = "mtd0"
SPLASH1_BMP = "splash1_power.bmp"

IMAGEDIR = "update/optimussos/cfe"

MACHINE_ESSENTIAL_EXTRA_RDEPENDS += "\
    dags-dvb-modules-dags7362 \
    "

include conf/machine/include/dags-mips.inc

PREFERRED_VERSION_linux-dags = "4.2.1"

SOC_FAMILY = "bcm7362"

MACHINE_FEATURES += "wifiusbmodule blindscan-tbs"
#MACHINE_FEATURES += "bootsplash"
```

## conf/machine/optimussos1.conf
```bitbake
#
# This is config file for Edision Optimuss OS1
#

MTD_KERNEL = "mtd1"
MTD_ROOTFS = "mtd4"

IMAGEDIR = "update/optimussos1/cfe"

MACHINE_ESSENTIAL_EXTRA_RDEPENDS += "\
    dags-dvb-modules-dags7335 \
    edision-tuner-edicombo \
    "

include conf/machine/include/dags-mips.inc

PREFERRED_VERSION_linux-dags = "3.9.7"

SOC_FAMILY = "bcm7335"

MACHINE_FEATURES += "fan wifiusbmodule blindscan-tbs"
```

## conf/machine/optimussos2plus.conf
```bitbake
#
# This is config file for Edision Optimuss OS2 Plus
#

MTD_KERNEL = "mtd2"
MTD_ROOTFS = "mtd0"
SPLASH1_BMP = "splash1_os2.bmp"

IMAGEDIR = "update/optimussos2plus/cfe"

MACHINE_ESSENTIAL_EXTRA_RDEPENDS += "\
    dags-dvb-modules-dags7356 \
    kernel-module-dvb-usb \
    edision-tuner-edicombo \
    "

require conf/machine/include/dags-mips.inc

PREFERRED_VERSION_linux-dags = "3.9.7"

SOC_FAMILY = "bcm7356"

MACHINE_FEATURES += "fan wifiusbmodule blindscan-tbs"
```

## conf/machine/optimussos3plus.conf
```bitbake
#
# This is config file for Edision Optimuss OS3 Plus
#

MTD_KERNEL = "mtd2"
MTD_ROOTFS = "mtd0"
SPLASH1_BMP = "splash1_os2.bmp"

IMAGEDIR = "update/optimussos3plus/cfe"

MACHINE_ESSENTIAL_EXTRA_RDEPENDS += "\
    dags-dvb-modules-dags7356 \
    kernel-module-dvb-usb \
    edision-tuner-edicombo \
    "

require conf/machine/include/dags-mips.inc

PREFERRED_VERSION_linux-dags = "3.9.7"

SOC_FAMILY = "bcm7356"

MACHINE_FEATURES += "fan blindscan-tbs RCA"
```

## conf/machine/purehdse.conf
```bitbake
#
# This is config file for Xsarius Pure HD SE
#

MTD_KERNEL = "mtd2"
MTD_ROOTFS = "mtd0"
SPLASH1_BMP = "splash1_power.bmp"

IMAGEDIR = "update/purehdse/cfe"

MACHINE_ESSENTIAL_EXTRA_RDEPENDS += "\
    dags-dvb-modules-dags73625 \
    "

require conf/machine/include/dags-mips.inc

PREFERRED_VERSION_linux-dags = "4.2.1"

SOC_FAMILY = "bcm73625"

MACHINE_FEATURES += "blindscan-tbs fastscan dvb-c"

STB_PLATFORM = "dags73625"
```

## conf/machine/revo4k.conf
```bitbake
#
# This is config file for Xsarius Revo 4K
#

MTD_KERNEL = "mmcblk0p1"
MTD_ROOTFS = "mmcblk0p4"
SPLASH1_BMP = "splash1_power.bmp"

IMAGEDIR = "update/revo4k"

MACHINE_ESSENTIAL_EXTRA_RDEPENDS += "\
    dags-dvb-modules-dags7252-200 \
    "

include conf/machine/include/dags-arm.inc

PREFERRED_VERSION_linux-dags = "3.14.28"

SOC_FAMILY = "bcm7252s"

MACHINE_FEATURES += "emmc mmc transcoding streamproxy"
```

## conf/machine/tm2t.conf
```bitbake
#
# This is config file for Technomate TM-2T-OE
#

MTD_KERNEL = "mtd6"
MTD_ROOTFS = "mtd4"

IMAGEDIR = "update/tm2toe/cfe"

MACHINE_ESSENTIAL_EXTRA_RDEPENDS += "\
    dags-dvb-modules-dags7335 \
    "

include conf/machine/include/dags-mips.inc

PREFERRED_VERSION_linux-dags = "3.9.7"

SOC_FAMILY = "bcm7335"

MACHINE_FEATURES += "fan wifiusbmodule blindscan-tbs"
#MACHINE_FEATURES += "bootsplash"
```
